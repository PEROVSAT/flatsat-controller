## west.yml
```yaml
manifest:
  remotes:
    - name: zephyrproject-rtos
      url-base: https://github.com/zephyrproject-rtos
    - name: origin
      url-base: https://github.com/PEROVSAT
  projects:
    - name: zephyr
      remote: zephyrproject-rtos
      revision: v4.4.0
      import:
        name-allowlist:
          - cmsis
          - cmsis_6
          - hal_rpi_pico

    - name: basilisk-simulation
      remote: origin
      revision: 2c02fb347ac6e5492b3f11f0b09fe662526880fd

    - name: mpu6050-emulator
      remote: origin
      path: emulated-devices/mpu6050
      revision: cde0e6f19aa68e6bb5ed39257c95cb0288df2422

    - name: hitl-bridge
      remote: origin
      path: hitl-bridge
      revision: 750e18f3dcb157fafbbed82a04f61b28bd5b249e

    - name: perovsat-protocol
      remote: origin
      path: perovsat-protocol
      revision: main

  self:
    path: flatsat-controller
```
